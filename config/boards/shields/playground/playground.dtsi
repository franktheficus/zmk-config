left_encoder: encoder_left {
        compatible = "alps,ec11";
        label = "LEFT_ENCODER";
        a-gpios = <D8 (GPIO_ACTIVE_HIGH | GPIO_PULL_UP)>;
        b-gpios = <D7 (GPIO_ACTIVE_HIGH | GPIO_PULL_UP)>;
        resolution = <4>;
    };