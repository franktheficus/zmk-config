## config/boards/shields/chocGranada/Kconfig.defconfig
```kconfig
if SHIELD_CHOCGRANADA

config ZMK_KEYBOARD_NAME
    default "chocGranada"

endif
```

## config/boards/shields/cradiod/Kconfig.defconfig
```kconfig
if SHIELD_CRADIOD_DONGLE

config ZMK_KEYBOARD_NAME
	default "Cradiod"

config ZMK_SPLIT_BLE_ROLE_CENTRAL
	default y

endif

if SHIELD_CRADIOD_LEFT || SHIELD_CRADIOD_RIGHT || SHIELD_CRADIOD_DONGLE

config ZMK_SPLIT
	default y

endif
```

## config/boards/shields/cradiod/Kconfig.shield
```kconfig
config SHIELD_CRADIOD_LEFT
	def_bool $(shields_list_contains,cradiod_left)
config SHIELD_CRADIOD_RIGHT
	def_bool $(shields_list_contains,cradiod_right)
config SHIELD_CRADIOD_DONGLE
	def_bool $(shields_list_contains,cradiod_dongle)
```

## config/boards/shields/ecorn/Kconfig.defconfig
```kconfig
if SHIELD_ECORN_LEFT

config ZMK_KEYBOARD_NAME
	default "eCorn"

config ZMK_SPLIT_BLE_ROLE_CENTRAL
	default y

endif

if SHIELD_ECORN_LEFT || SHIELD_ECORN_RIGHT

config ZMK_SPLIT
	default y

endif
```

## config/boards/shields/ecorn/Kconfig.shield
```kconfig
config SHIELD_ECORN_LEFT
	def_bool $(shields_list_contains,ecorn_left)

config SHIELD_ECORN_RIGHT
	def_bool $(shields_list_contains,ecorn_right)
```

## config/boards/shields/granadav/Kconfig.defconfig
```kconfig
if SHIELD_GRANADAV_LEFT

config ZMK_KEYBOARD_NAME
	default "granadaV"

config ZMK_SPLIT_BLE_ROLE_CENTRAL
	default y

endif

if SHIELD_GRANADAV_LEFT || SHIELD_GRANADAV_RIGHT

config ZMK_SPLIT
	default y

endif
```

## config/boards/shields/granadav/Kconfig.shield
```kconfig
config SHIELD_GRANADAV_LEFT
	def_bool $(shields_list_contains,granadav_left)

config SHIELD_GRANADAV_RIGHT
	def_bool $(shields_list_contains,granadav_right)
```

## config/boards/shields/playground/Kconfig.defconfig
```kconfig
if SHIELD_PLAYGROUND

config ZMK_KEYBOARD_NAME
    default "Some board"

config ZMK_BLE
    default y

endif
```

## config/west.yml
```yaml
manifest:
  remotes:
    - name: stephen
      url-base: https://github.com/stephen
  projects:
    - name: zmk
      remote: stephen
      revision: stephen/split-encoder
      import: app/west.yml
  self:
    path: config
```
